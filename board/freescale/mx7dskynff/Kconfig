## board/freescale/mx7dskynff/Kconfig
```kconfig
if TARGET_MX7DSKYNFF

config SYS_BOARD
	default "mx7dskynff"

config SYS_VENDOR
	default "freescale"

config SYS_CONFIG_NAME
	default "mx7dskynff"

endif
```
